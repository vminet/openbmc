## meta-hpe/meta-dl325poc/conf/layer.conf
```bitbake
# We have a conf and classes directory, add to BBPATH
BBPATH .= ":${LAYERDIR}"

# We have recipes-* directories, add to BBFILES
BBFILES += "${LAYERDIR}/recipes-*/*/*.bb \
            ${LAYERDIR}/recipes-*/*/*.bbappend"

BBFILE_COLLECTIONS += "dl325poc-layer"
BBFILE_PATTERN_dl325poc-layer := "^${LAYERDIR}/"
LAYERSERIES_COMPAT_dl325poc-layer = "dunfell gatesgarth"
```
